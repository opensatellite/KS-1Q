// -------------------------------------------------------------
//
// File Name: hdl_prj\hdlsrc\ccsds_encoder\ASM_Generator.v
// Created: 2016-05-22 11:42:29
//
// Generated by WarMonkey, Hand-coded
//
// -------------------------------------------------------------


// -------------------------------------------------------------
//
// Module: ASM_Generator
// Source Path: ccsds_encoder/ASM Generator
// Hierarchy Level: 1
//
// -------------------------------------------------------------
// -------------------------------------------------------------
//
// File Name: hdl_prj\hdlsrc\ccsds_encoder\ASM_Generator.v
// Created: 2016-05-22 11:42:29
//
// Generated by WarMonkey, Hand-coded
//
// -------------------------------------------------------------


// -------------------------------------------------------------
//
// Module: ASM_Generator
// Source Path: ccsds_encoder/ASM Generator
// Hierarchy Level: 1
//
// -------------------------------------------------------------

`timescale 1 ns / 1 ns

module ASM_Generato
          (
           clk,
           reset,
           En_ASM,
           out,
           pending,
           En_ASM_Out
          );

  input   clk;
  input   reset;
  input   En_ASM;
  output  out,pending,En_ASM_Out;
  reg     pending;
  parameter pattern = 32'h1acffc1d;
  reg [31:0] stream;
  reg En_ASM_Out,out;






  always @(posedge (clk ) or negedge reset /*or negedge En_ASM*/)begin 
  if(!reset) begin
    stream <= pattern;
    En_ASM_Out<=0;
    out<=0;
    end 
  else begin 
    if(stream==pattern)begin 
      pending<=1;
      end
    else pending<=0;
   En_ASM_Out<=En_ASM;
   if(En_ASM)begin
     stream <= stream << 1;
     out <= stream[31];
    //if(stream==0)begin pending<=0;done<=1;end
     end
   else if(!En_ASM)begin
    stream <= pattern;
    out <= 0;
    end
  else begin 
    end 
  end

end

//  assign out = stream[31];
  //assign pending = stream==pattern ? 1 : 0 ;
  //assign done = stream==0 ? 1 : 0 ;

  
endmodule  // ASM_Generator




